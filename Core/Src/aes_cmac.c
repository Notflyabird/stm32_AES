#include "aes_cmac.h"
#include "usart.h"
#include <string.h>
#include <stdio.h>

// --- 内部辅助函数 ---

// 左移16字节块（处理溢出）
static void left_shift_block(const uint8_t *in, uint8_t *out) {
    uint8_t overflow = 0;
    for (int i = AES_BLOCK_SIZE - 1; i >= 0; i--) {
        out[i] = (in[i] << 1) | overflow;
        overflow = (in[i] & 0x80) ? 1 : 0;
    }
}

// 16字节块异或
static void xor_block(const uint8_t *a, const uint8_t *b, uint8_t *out) {
    for (int i = 0; i < AES_BLOCK_SIZE; i++) {
        out[i] = a[i] ^ b[i];
    }
}

// 串口打印十六进制（辅助调试）
static void uart_print_hex(const uint8_t *data, uint32_t len, const char *prefix) {
    HAL_UART_Transmit(&huart1, (uint8_t*)prefix, strlen(prefix), 0xFFFF);
    for (uint32_t i = 0; i < len; i++) {
        uint8_t hex[3];
        sprintf((char*)hex, "%02X ", data[i]);
        HAL_UART_Transmit(&huart1, hex, 3, 0xFFFF);
    }
    HAL_UART_Transmit(&huart1, (uint8_t*)"\r\n", 2, 0xFFFF);
}

// --- AES-128核心实现（修复部分）---

// AES S盒（正确）
static const uint8_t sbox[256] = {
    0x63,0x7c,0x77,0x7b,0xf2,0x6b,0x6f,0xc5,0x30,0x01,0x67,0x2b,0xfe,0xd7,0xab,0x76,
    0xca,0x82,0xc9,0x7d,0xfa,0x59,0x47,0xf0,0xad,0xd4,0xa2,0xaf,0x9c,0xa4,0x72,0xc0,
    0xb7,0xfd,0x93,0x26,0x36,0x3f,0xf7,0xcc,0x34,0xa5,0xe5,0xf1,0x71,0xd8,0x31,0x15,
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    0x8c,0xa1,0x89,0x0d,0xbf,0xe6,0x42,0x68,0x41,0x99,0x2d,0x0f,0xb0,0x54,0xbb,0x16
};

// 伽罗瓦域乘法（x2）表（正确）
static const uint8_t gmul2[256] = {
    0x00,0x02,0x04,0x06,0x08,0x0a,0x0c,0x0e,0x10,0x12,0x14,0x16,0x18,0x1a,0x1c,0x1e,
    0x20,0x22,0x24,0x26,0x28,0x2a,0x2c,0x2e,0x30,0x32,0x34,0x36,0x38,0x3a,0x3c,0x3e,
    0x40,0x42,0x44,0x46,0x48,0x4a,0x4c,0x4e,0x50,0x52,0x54,0x56,0x58,0x5a,0x5c,0x5e,
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    0xfb,0xf9,0xff,0xfd,0xf3,0xf1,0xf7,0xf5,0xeb,0xe9,0xef,0xed,0xe3,0xe1,0xe7,0xe5
};

// 轮常量（AES-128标准，共10轮）【修复点1：使用正确轮常量】
static const uint8_t rcon[10] = {0x01, 0x02, 0x04, 0x08, 0x10, 0x20, 0x40, 0x80, 0x1b, 0x36};

// 轮密钥加（正确）
static void add_round_key(uint8_t *state, const uint8_t *key) {
    for (int i = 0; i < AES_BLOCK_SIZE; i++) {
        state[i] ^= key[i];
    }
}

// 字节替换（正确）
static void sub_bytes(uint8_t *state) {
    for (int i = 0; i < AES_BLOCK_SIZE; i++) {
        state[i] = sbox[state[i]];
    }
}

// 行移位（正确）
static void shift_rows(uint8_t *state) {
    uint8_t temp;
    // 第2行左移1位
    temp = state[1];
    state[1] = state[5];
    state[5] = state[9];
    state[9] = state[13];
    state[13] = temp;
    // 第3行左移2位
    temp = state[2];
    state[2] = state[10];
    state[10] = temp;
    temp = state[6];
    state[6] = state[14];
    state[14] = temp;
    // 第4行左移3位
    temp = state[3];
    state[3] = state[15];
    state[15] = state[11];
    state[11] = state[7];
    state[7] = temp;
}

// 列混合（修复点2：正确的列混合公式）
static void mix_columns(uint8_t *state) {
    uint8_t a, b, c, d;
    for (int i = 0; i < 4; i++) {
        a = state[4*i];
        b = state[4*i + 1];
        c = state[4*i + 2];
        d = state[4*i + 3];
        
        // 正确公式：列混合基于伽罗瓦域乘法
        state[4*i]     = gmul2[a] ^ (gmul2[b] ^ b) ^ c ^ d;  // 2a + 3b + c + d
        state[4*i + 1] = a ^ gmul2[b] ^ (gmul2[c] ^ c) ^ d;  // a + 2b + 3c + d
        state[4*i + 2] = a ^ b ^ gmul2[c] ^ (gmul2[d] ^ d);  // a + b + 2c + 3d
        state[4*i + 3] = (gmul2[a] ^ a) ^ b ^ c ^ gmul2[d];  // 3a + b + c + 2d
    }
}

// 密钥扩展（修复点3：使用轮常量数组）
static void aes_key_expansion(const uint8_t *key, uint8_t *w) {
    uint8_t temp[4];
    uint8_t i;
    // 初始轮密钥（前4个字）
    for (i = 0; i < 4; i++) {
        w[4*i] = key[4*i];
        w[4*i + 1] = key[4*i + 1];
        w[4*i + 2] = key[4*i + 2];
        w[4*i + 3] = key[4*i + 3];
    }
    // 扩展剩余轮密钥（共44个字，11轮）
    for (; i < 44; i++) {
        temp[0] = w[4*(i-1) + 0];
        temp[1] = w[4*(i-1) + 1];
        temp[2] = w[4*(i-1) + 2];
        temp[3] = w[4*(i-1) + 3];
        
        if (i % 4 == 0) {  // 每4个字轮换
            // 旋转、S盒替换
            uint8_t t = temp[0];
            temp[0] = sbox[temp[1]];
            temp[1] = sbox[temp[2]];
            temp[2] = sbox[temp[3]];
            temp[3] = sbox[t];
            // 异或轮常量（使用正确的rcon数组）
            temp[0] ^= rcon[(i/4) - 1];
        }
        
        // 生成新轮密钥
        w[4*i + 0] = w[4*(i-4) + 0] ^ temp[0];
        w[4*i + 1] = w[4*(i-4) + 1] ^ temp[1];
        w[4*i + 2] = w[4*(i-4) + 2] ^ temp[2];
        w[4*i + 3] = w[4*(i-4) + 3] ^ temp[3];
    }
}

// AES-128 ECB加密（修复后）
static void aes128_ecb_encrypt(const uint8_t *key, const uint8_t *input, uint8_t *output) {
    uint8_t state[AES_BLOCK_SIZE];
    uint8_t w[176];  // 11轮密钥（176字节）
    aes_key_expansion(key, w);
    
    memcpy(state, input, AES_BLOCK_SIZE);
    add_round_key(state, w);  // 初始轮
    
    // 中间9轮
    for (int round = 1; round < 10; round++) {
        sub_bytes(state);
        shift_rows(state);
        mix_columns(state);
        add_round_key(state, w + round * AES_BLOCK_SIZE);
    }
    
    // 最后一轮（无列混合）
    sub_bytes(state);
    shift_rows(state);
    add_round_key(state, w + 10 * AES_BLOCK_SIZE);
    
    memcpy(output, state, AES_BLOCK_SIZE);
}

// --- 子密钥生成（正确）---
static void generate_subkeys(const uint8_t *key, uint8_t *K1, uint8_t *K2) {
    uint8_t L[AES_BLOCK_SIZE] = {0};  // 全零块
    aes128_ecb_encrypt(key, L, L);   // 计算L = AES(key, 0)
    
    // 生成K1
    left_shift_block(L, K1);
    if (L[0] & 0x80) {  // 最高位为1，异或Rb
        K1[AES_BLOCK_SIZE - 1] ^= Rb;
    }
    
    // 生成K2
    left_shift_block(K1, K2);
    if (K1[0] & 0x80) {  // 最高位为1，异或Rb
        K2[AES_BLOCK_SIZE - 1] ^= Rb;
    }
}

// --- AES-CMAC核心函数 ---
void aes_cmac_init(AES_CMAC_CTX *ctx, const uint8_t *key) {
    memcpy(ctx->key, key, AES_BLOCK_SIZE);
}

void aes_cmac_compute(AES_CMAC_CTX *ctx, const uint8_t *msg, uint32_t msg_len, uint8_t *out_mac) {
    uint8_t K1[AES_BLOCK_SIZE], K2[AES_BLOCK_SIZE];
    generate_subkeys(ctx->key, K1, K2);
    
    uint32_t n = (msg_len + AES_BLOCK_SIZE - 1) / AES_BLOCK_SIZE;  // 总块数
    uint8_t last_block[AES_BLOCK_SIZE] = {0};
    
    if (n == 0) n = 1;  // 空消息处理
    
    // 处理最后一块
    if (msg_len % AES_BLOCK_SIZE != 0) {
        // 非整数块：填充后异或K2
        uint32_t last_len = msg_len % AES_BLOCK_SIZE;
        memcpy(last_block, msg + (n-1)*AES_BLOCK_SIZE, last_len);
        last_block[last_len] = 0x80;  // 填充标志
        xor_block(last_block, K2, last_block);
    } else {
        // 整数块：异或K1
        memcpy(last_block, msg + (n-1)*AES_BLOCK_SIZE, AES_BLOCK_SIZE);
        xor_block(last_block, K1, last_block);
    }
    
    // 迭代计算CMAC
    uint8_t X[AES_BLOCK_SIZE] = {0};
    uint8_t Y[AES_BLOCK_SIZE];
    
    for (uint32_t i = 0; i < n-1; i++) {
        xor_block(X, msg + i*AES_BLOCK_SIZE, Y);
        aes128_ecb_encrypt(ctx->key, Y, X);
    }
    
    xor_block(X, last_block, Y);
    aes128_ecb_encrypt(ctx->key, Y, out_mac);
}


// CMAC测试（标准向量）
void aes_cmac_test(void) {
    // 标准CMAC测试向量
    uint8_t key[16] = {
        0x2b, 0x7e, 0x15, 0x16, 0x28, 0xae, 0xd2, 0xa6,
        0xab, 0xf7, 0x15, 0x88, 0x09, 0xcf, 0x4f, 0x3c
    };
    uint8_t message[16] = {
        0x6b, 0xc1, 0xbe, 0xe2, 0x2e, 0x40, 0x9f, 0x96,
        0xe9, 0x3d, 0x7e, 0x11, 0x73, 0x93, 0x17, 0x2a
    };
    uint8_t expected_mac[16] = {
        0x07, 0x0a, 0x16, 0xb4, 0x6b, 0x4d, 0x41, 0x44,
        0xf7, 0x9b, 0xdd, 0x9d, 0xd0, 0x4a, 0x28, 0x7c
    };
    
    uint32_t msg_len = sizeof(message);
    uint8_t computed_mac[16];
    
    AES_CMAC_CTX ctx;
    aes_cmac_init(&ctx, key);
    aes_cmac_compute(&ctx, message, msg_len, computed_mac);
    
    uart_print_hex(message, msg_len, "Message:    ");
    uart_print_hex(expected_mac, 16, "Expected MAC: ");
    uart_print_hex(computed_mac, 16, "Computed MAC: ");
    

}
